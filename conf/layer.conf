## conf/layer.conf
```bitbake
# We have a conf and classes directory, add to BBPATH
BBPATH .= ":${LAYERDIR}"

# We have recipes-* directories, add to BBFILES
BBFILES += "${LAYERDIR}/recipes-*/*/*.bb \
            ${LAYERDIR}/recipes-*/*/*.bbappend"

BBFILE_COLLECTIONS += "meta-custom-dev-apps"
BBFILE_PATTERN_meta-custom-dev-apps = "^${LAYERDIR}/"
BBFILE_PRIORITY_meta-custom-dev-apps = "6"

LAYERDEPENDS_meta-custom-dev-apps = "core"
LAYERSERIES_COMPAT_meta-custom-dev-apps = "dunfell"
```
